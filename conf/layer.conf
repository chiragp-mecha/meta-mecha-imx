## conf/layer.conf
```bitbake
# We have a conf and classes directory, add to BBPATH
BBPATH .= ":${LAYERDIR}"

# We have recipes-* directories, add to BBFILES
BBFILES += "${LAYERDIR}/recipes-*/*/*.bb \
            ${LAYERDIR}/recipes-*/*/*.bbappend"

BBFILE_COLLECTIONS += "meta-mecha-imx"
BBFILE_PATTERN_meta-mecha-imx = "^${LAYERDIR}/"
BBFILE_PRIORITY_meta-mecha-imx = "6"

LAYERDEPENDS_meta-mecha-imx = "core"
LAYERSERIES_COMPAT_meta-mecha-imx = "kirkstone mickledore"

CORE_IMAGE_EXTRA_INSTALL += "u-boot-fw-utils"
CORE_IMAGE_EXTRA_INSTALL += "coreutils keyutils lvm2 e2fsprogs-mke2fs util-linux"
IMAGE_INSTALL:append = " enable-fw-printenv-userspace" 

IMAGE_INSTALL:append = " lvm2 keyutils" 
IMAGE_INSTALL:append = " kernel-devicetree kernel-image"
IMAGE_INSTALL:append = " udev udev-extraconf" 
IMAGE_INSTALL:append = " cameraservices"
WKS_FILE = " mecha-comet-boot-bootpart.wks.in"
 

# Enable Device Tree Overlays 
IMAGE_INSTALL:append = " overlays "
# IMAGE_BOOT_FILES:append = " overlays.txt "

IMAGE_BOOT_FILES = "Image"
IMAGE_BOOT_FILES:append = " imx8mm-mecha-comet-m-gen1.dtb"
IMAGE_BOOT_FILES:append = " ${BSPDIR}/sources/meta-mecha-imx/recipes-bsp/u-boot/u-boot-logos/*"
#IMAGE_BOOT_FILES:append = " ${BSPDIR}/sources/meta-mecha-imx/recipes-bsp/overlays/files/overlays.txt"

# KERNEL_DTC_FLAGS += "-@"
```

## conf/machine/mecha-comet-m-gen1.conf
```bitbake
# from meta-freescale/conf
require conf/machine/imx8mm-lpddr4-evk.conf

MACHINEOVERRIDES_EXTENDER:mx8mm:use-nxp-bsp  = "imx-generic-bsp:imx-nxp-bsp:imxdrm:imxvpu:etnaviv:mx8-generic-bsp:mx8-nxp-bsp:mx8m-generic-bsp:mx8m-nxp-bsp:mx8mm-generic-bsp:mx8mm-nxp-bsp"

APPEND += "printk.time=y initcall_debug debug"

# Remove extra dtb from imx8mm-lpddr4-evk.conf and imx8mm-evk.inc
KERNEL_DEVICETREE:remove:use-nxp-bsp = " \
    freescale/${KERNEL_DEVICETREE_BASENAME}-8mic-revE.dtb \
    freescale/${KERNEL_DEVICETREE_BASENAME}-8mic-swpdm.dtb \
    freescale/${KERNEL_DEVICETREE_BASENAME}-ak4497.dtb \
    freescale/${KERNEL_DEVICETREE_BASENAME}-ak5558.dtb \
    freescale/${KERNEL_DEVICETREE_BASENAME}-audio-tdm.dtb \
    freescale/${KERNEL_DEVICETREE_BASENAME}-dpdk.dtb \
    freescale/${KERNEL_DEVICETREE_BASENAME}-ecspi-slave.dtb \
    freescale/${KERNEL_DEVICETREE_BASENAME}-lk.dtb \
    freescale/${KERNEL_DEVICETREE_BASENAME}-inmate.dtb \
    freescale/${KERNEL_DEVICETREE_BASENAME}-qca-wifi.dtb \
    freescale/${KERNEL_DEVICETREE_BASENAME}-revb-qca-wifi.dtb \
    freescale/${KERNEL_DEVICETREE_BASENAME}-root.dtb \
    freescale/${KERNEL_DEVICETREE_BASENAME}-rpmsg.dtb \
    freescale/${KERNEL_DEVICETREE_BASENAME}-rpmsg-wm8524.dtb \
    freescale/${KERNEL_DEVICETREE_BASENAME}-rpmsg-wm8524-lpv.dtb \
    freescale/${KERNEL_DEVICETREE_BASENAME}-usd-wifi.dtb \
    freescale/${KERNEL_DEVICETREE_BASENAME}-pcie-ep.dtb \
    freescale/${KERNEL_DEVICETREE_BASENAME}-rm67191.dtb \
    freescale/${KERNEL_DEVICETREE_BASENAME}-rm67191-cmd-ram.dtb \
    freescale/${KERNEL_DEVICETREE_BASENAME}-rm67199.dtb \
    freescale/${KERNEL_DEVICETREE_BASENAME}-rm67199-cmd-ram.dtb \
"

# Add Kernel DTB to boot partition kernel_devicetree 
KERNEL_DEVICETREE = "freescale/imx8mm-mecha-comet-m-gen1.dtb"
KERNEL_DEVICETREE:append = " freescale/imx8mm-mecha-som-gen1.dtb"
KERNEL_DEVICETREE:append = " freescale/imx8mm-mecha-som-gen1-ramfs.dtb"

UBOOT_CONFIG_BASENAME = "mecha_comet"
UBOOT_CONFIG[fspi]  = "mecha_comet_defconfig"
```
